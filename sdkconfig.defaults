## sdkconfig.defaults
```kconfig
# CONFIG_AUTOSTART_ARDUINO=y
# CONFIG_WS2812_LED_ENABLE is not set
CONFIG_FREERTOS_HZ=1000
CONFIG_MBEDTLS_PSK_MODES=y
CONFIG_MBEDTLS_KEY_EXCHANGE_PSK=y

# CONFIG_BT_ENABLED=y
# CONFIG_BTDM_CTRL_MODE_BLE_ONLY=n
# CONFIG_BTDM_CTRL_MODE_BR_EDR_ONLY=y
# CONFIG_BTDM_CTRL_MODE_BTDM=n
# CONFIG_BT_BLUEDROID_ENABLED=y
# CONFIG_BT_CLASSIC_ENABLED=y
# CONFIG_BT_A2DP_ENABLE=y
# CONFIG_BT_SPP_ENABLED=y
# CONFIG_BT_BLE_ENABLED=n
```
